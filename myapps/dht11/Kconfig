## myapps/dht11/Kconfig
```kconfig
config MY_APPS_DHT11
	tristate "DHT11"
	default n
	---help---
		Enable the DHT11 application
```

## myapps/hello/Kconfig
```kconfig
config MY_APPS_HELLO
        tristate "Hello"
        default n
        ---help---
                Enable the My Hello App
```

## myapps/lcdtest/Kconfig
```kconfig
config MY_APPS_LCDTEST
	tristate "LCD Test"
	default n
	---help---
		Enable the LCD test application
```

## myapps/led/Kconfig
```kconfig
config MY_APPS_LED
        tristate "LED"
        default n
        ---help---
                Enable the My LED App
```

## myapps/lvgl_demo/Kconfig
```kconfig
config MY_APPS_LVGL_DEMO
	tristate "LVGL Demo"
	default n
	---help---
		Enable the LVGL Demo application
```

## myapps/wifi/Kconfig
```kconfig
config MY_APPS_WIFI
	tristate "Wifi"
	default n
	---help---
		Enable the WIFI application
```
